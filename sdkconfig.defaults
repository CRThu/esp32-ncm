## sdkconfig.defaults
```kconfig
CONFIG_IDF_TARGET="esp32s3"
CONFIG_ESPTOOLPY_FLASHSIZE_4MB=y
CONFIG_ESPTOOLPY_FLASHSIZE="4MB"

# Console on UART0 (COM7)
CONFIG_ESP_CONSOLE_UART_DEFAULT=y
CONFIG_ESP_CONSOLE_UART_NUM=0
CONFIG_ESP_CONSOLE_UART_BAUDRATE=115200

# TinyUSB NCM Network Device (Native Win11 / Linux / macOS)
CONFIG_TINYUSB_NET_MODE_NCM=y
CONFIG_TINYUSB_NET_MODE_ECM_RNDIS=n

# LwIP IP Forwarding and NAPT
CONFIG_LWIP_IP_FORWARD=y
CONFIG_LWIP_IPV4_NAPT=y
CONFIG_LWIP_IPV4_NAPT_PORTMAP=y
CONFIG_LWIP_L2_TO_L3_COPY=y

# HTTP Server tuning
CONFIG_HTTPD_MAX_REQ_HDR_LEN=1024
CONFIG_HTTPD_MAX_URI_LEN=512

# System Event Task Stack (prevent stack overflow on wifi events)
CONFIG_ESP_SYSTEM_EVENT_TASK_STACK_SIZE=4096

# Wi-Fi 吞吐加速 (A-MPDU 窗口与动态缓冲扩容)
CONFIG_ESP_WIFI_RX_BA_WIN=16
CONFIG_ESP_WIFI_TX_BA_WIN=16
CONFIG_ESP_WIFI_DYNAMIC_RX_BUFFER_NUM=64
CONFIG_ESP_WIFI_DYNAMIC_TX_BUFFER_NUM=64
CONFIG_ESP_WIFI_AMPDU_TX_ENABLED=y
CONFIG_ESP_WIFI_AMPDU_RX_ENABLED=y

# LwIP 吞吐加速 (扩大滑动窗口与收发邮箱)
CONFIG_LWIP_TCP_SND_BUF_DEFAULT=14400
CONFIG_LWIP_TCP_WND_DEFAULT=14400
CONFIG_LWIP_TCP_RECVMBOX_SIZE=32
CONFIG_LWIP_TCPIP_RECVMBOX_SIZE=64

# TinyUSB CDC-NCM NTB 聚合缓冲扩容
CONFIG_TINYUSB_NCM_OUT_NTB_BUFF_MAX_SIZE=6400
CONFIG_TINYUSB_NCM_IN_NTB_BUFF_MAX_SIZE=6400
CONFIG_TINYUSB_NCM_OUT_NTB_BUFFS_COUNT=4
CONFIG_TINYUSB_NCM_IN_NTB_BUFFS_COUNT=6

# 核心算力与供电平衡 (160MHz 稳态功耗，-O2 编译优化，IRAM 零等待)
CONFIG_ESP_DEFAULT_CPU_FREQ_MHZ_160=y
CONFIG_ESP_DEFAULT_CPU_FREQ_MHZ=160
CONFIG_COMPILER_OPTIMIZATION_PERF=y
CONFIG_LWIP_IRAM_OPTIMIZATION=y
CONFIG_ESP_WIFI_EXTRA_IRAM_OPT=y
CONFIG_FREERTOS_HZ=1000
```
